## lab2-2024E8021682118/meta-2024E8021682118/conf/layer.conf
```bitbake
# ~/lab2-2024E8021682118/meta-2024E8021682118/conf/layer.conf
BBPATH .= ":${LAYERDIR}"
BBFILES += "${LAYERDIR}/recipes-*/*/*.bb"
BBFILE_COLLECTIONS += "2024E8021682118"
BBFILE_PATTERN_2024E8021682118 = "^${LAYERDIR}/"
BBFILE_PRIORITY_2024E8021682118 = "10"
```
